## main/Kconfig.projbuild
```kconfig
menu "Machine Hardware Configuration"

    menu "X-Axis Pins"
        config X_STEP_GPIO
            int "X Step GPIO"
            default 12
        config X_DIR_GPIO
            int "X Dir GPIO"
            default 14
        config X_LIMIT_GPIO
            int "X Limit GPIO"
            default 34
    endmenu

    menu "Y-Axis Pins"
        config Y_STEP_GPIO
            int "Y Step GPIO"
            default 27
        config Y_DIR_GPIO
            int "Y Dir GPIO"
            default 26
        config Y_LIMIT_GPIO
            int "Y Limit GPIO"
            default 35
    endmenu

    menu "Z-Axis Pins"
        config Z_STEP_GPIO
            int "Z Step GPIO"
            default 25
        config Z_DIR_GPIO
            int "Z Dir GPIO"
            default 33
        config Z_LIMIT_GPIO
            int "Z Limit GPIO"
            default 36
    endmenu

    menu "A-Axis Pins"
        config A_STEP_GPIO
            int "A Step GPIO"
            default 32
        config A_DIR_GPIO
            int "A Dir GPIO"
            default 13
        config A_LIMIT_GPIO
            int "A Limit GPIO"
            default 39
    endmenu

    menu "HX711 Loadcell Pins"
        config HX711_SCK_GPIO
            int "HX711 SCK GPIO"
            default 15
        config HX711_DT_GPIO
            int "HX711 DT GPIO"
            default 4
    endmenu

endmenu
```
